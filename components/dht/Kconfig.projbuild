## components/dht/Kconfig.projbuild
```kconfig
menu "DHT Sensor Configuration"
    choice DHT_SENSOR_TYPE
        prompt "DHT Sensor Type"
        help
            Select the type of DHT sensor attached
        
        config DHT_SENSOR_TYPE_11
            bool "DHT11"
        config DHT_SENSOR_TYPE_12
            bool "DHT12"
        config DHT_SENSOR_TYPE_21
            bool "DHT21"
        config DHT_SENSOR_TYPE_22
            bool "DHT22"
        config DHT_SENSOR_TYPE_AM2301
            bool "AM2301"
    endchoice

    config DHT_GPIO
        int "GPIO Pin"
        default 13
        help
            Enter the GPIO Pin that the sensor is connected to
    
    config DHT_READ_RATE
        int "Sensor Read Rate"
        default 5000
        range 2000 30000
        help
            Enter the time in ms between sensor reads
endmenu
```

## components/esp-tahu/Kconfig.projbuild
```kconfig
menu "Sparkplug Configuration"
    config SPARKPLUG_GROUP_ID
        string "Sparkplug Group ID"
        default "env_sensors"
        help
            The Sparkplug Group ID associated with this application's
             MQTT data
endmenu
```

## components/mqtt-app/Kconfig.projbuild
```kconfig
menu "MQTT Configuration"
    config MQTT_BROKER_URI
        string "MQTT Broker URI"
        default "mqtts://broker.com:8883"
        help
            Full URI to MQTT broker (including port)
    config MQTT_MAX_ATTEMPTS
        int "Maximum connection attempts"
        default 3
        help
            Maximum times to attempt a connection to the MQTT Broker
    config MQTT_RECONNECT_DELAY
        int "Delay in seconds between reconnection attempts"
        default 10
        help
            Time in seconds to delay before attempting to reconnect to MQTT broker
    config MQTT_USE_SSL
        bool "SSL Transport"
        default TRUE
        help
            Enable SSL for broker communications.
            Save the broker's SSL certificate in the components certs folder with the name `mqtt_broker.pem`
    config MQTT_KEEPALIVE_PERIOD
        int "Keep Alive period"
        default 15
        help
            Period which MQTT server must receive a transmission from client
            or connection will be considered closed by server
    config MQTT_AUTO_KEEPALIVE_ENABLED
        bool "Enable Auto Keepalive"
        default TRUE
        help
            Enable auto-pings to MQTT server while connected to maintain keepalive window
    config MQTT_AUTH_ENABLED
        bool "Broker Authentication"
        default TRUE
        help
            Enable authentication to the broker
    config MQTT_USERNAME
        depends on MQTT_AUTH_ENABLED
        string "MQTT Client Username"
        default "user"
        help
            MQTT Client authentication username
    config MQTT_PASSWORD
        depends on MQTT_AUTH_ENABLED
        string "MQTT Client Password"
        default "password"
        help
            MQTT Client authentication password
endmenu
```

## components/temp-controller/Kconfig.projbuild
```kconfig
menu "Temp Controller Configuration"
    config TC_DEFAULT_SETPOINT
        int "Default Setpoint"
        default 40
        help
            Default temperature setpoint to use in °F
    config TC_OUT_GPIO_PIN
        int "GPIO Output PIN"
        default 15
        help
            GPIO Pin which fridge/freezer enable mechanism is tied to
    config TC_DEADBAND
        int "Temperature Deadband"
        default 3
        help
            Temperature (°F) to cool below setpoint before disabling fridge/freezer
endmenu
```

## components/wifi/Kconfig.projbuild
```kconfig
menu "WiFi Configuration"
    config WIFI_SSID
        string "Wifi SSID"
        default "NetworkSSID"
        help
            Enter SSID of Wi-Fi Network
    config WIFI_PASSWORD
        string "WiFi Password"
        default "password"
        help
            WiFi password (WPA or WPA2)

    config WIFI_MAXIMUM_RETRY
        int "Maximum retry"
        default 5
        help
            Set the Maximum retry to avoid station reconnecting to the AP unlimited when the AP is really inexistent.

    choice WIFI_SCAN_AUTH_MODE_THRESHOLD
        prompt "WiFi Scan auth mode threshold"
        default WIFI_AUTH_WPA2_PSK
        help
            The weakest authmode to accept in the scan mode.
            This value defaults to ESP_WIFI_AUTH_WPA2_PSK incase password is present and ESP_WIFI_AUTH_OPEN is used.
            Please select ESP_WIFI_AUTH_WEP/ESP_WIFI_AUTH_WPA_PSK incase AP is operating in WEP/WPA mode.

        config WIFI_AUTH_OPEN
            bool "OPEN"
        config WIFI_AUTH_WEP
            bool "WEP"
        config WIFI_AUTH_WPA_PSK
            bool "WPA PSK"
        config WIFI_AUTH_WPA2_PSK
            bool "WPA2 PSK"
        config WIFI_AUTH_WPA_WPA2_PSK
            bool "WPA/WPA2 PSK"
        config WIFI_AUTH_WPA3_PSK
            bool "WPA3 PSK"
        config WIFI_AUTH_WPA2_WPA3_PSK
            bool "WPA2/WPA3 PSK"
        config WIFI_AUTH_WAPI_PSK
            bool "WAPI PSK"
    endchoice
endmenu
```

## main/Kconfig.projbuild
```kconfig
menu "Application Settings"
    config APP_IMPL_TEMP_CONTROLLER
        bool "Temperature Controller Mode"
        default FALSE
        help
            Enable temperature controller functionality of application

    config APP_SPARKPLUG_DEVICE_ID_TEMP_CONTROLLER
        depends on APP_IMPL_TEMP_CONTROLLER
        string "Temp Controller Device ID"
        default "temp_controller"
        help
            The Sparkplug device ID to be used for MQTT data
            associated with temperature controller tags

    config APP_SPARKPLUG_DEVICE_ID_DHT
        string "DHT Sensor Device ID"
        default "dht"
        help
            The Sparkplug device ID to be used for MQTT data
            associated with the DHT sensor tags
endmenu
```
